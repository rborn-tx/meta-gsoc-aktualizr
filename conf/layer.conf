## conf/layer.conf
```bitbake
# We have a conf and classes directory, add to BBPATH
BBPATH .= ":${LAYERDIR}"

# We have recipes-* directories, add to BBFILES
BBFILES += "${LAYERDIR}/recipes-*/*/*.bb ${LAYERDIR}/recipes-*/*/*.bbappend"

BBFILE_COLLECTIONS += "meta-gsoc-aktualizr"
BBFILE_PATTERN_meta-gsoc-aktualizr = "^${LAYERDIR}/"
BBFILE_PRIORITY_meta-gsoc-aktualizr = "7"

LAYERDEPENDS_meta-gsoc-aktualizr = "openembedded-layer"
LAYERDEPENDS_meta-gsoc-aktualizr += "meta-python"
LAYERDEPENDS_meta-gsoc-aktualizr += "filesystems-layer"
LAYERSERIES_COMPAT_meta-gsoc-aktualizr = "kirkstone"

SIGGEN_EXCLUDE_SAFE_RECIPE_DEPS += " \
  aktualizr-device-prov->aktualizr \
  aktualizr-device-prov-hsm->aktualizr \
  aktualizr-shared-prov->aktualizr \
  aktualizr-shared-prov-creds->aktualizr \
  aktualizr-uboot-env-rollback->aktualizr \
"
```
